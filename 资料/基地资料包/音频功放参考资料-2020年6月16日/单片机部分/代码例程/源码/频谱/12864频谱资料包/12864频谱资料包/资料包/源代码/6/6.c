#include <stdio.h>
#include <math.h>
#include "STC15F2K60S2.H"
#include "INTRINS.H"
#include <string.h>
sbit Rest=P3^0;
sbit    RS =P2^5;
sbit    WRD=P2^6;
sbit    E=  P2^7;
sbit    PSB=P1^0;
sbit    RES=P1^2;
#define ADC_POWER   0x80            //ADC power control bit
#define ADC_FLAG    0x10            //ADC complete flag
#define ADC_START   0x08            //ADC start control bit
#define ADC_SPEEDLL 0x00            //420 clocks
#define ADC_SPEEDL  0x20            //280 clocks
#define ADC_SPEEDH  0x40            //140 clocks
#define ADC_SPEEDHH 0x60            //70 clocks		   			  
#define Process_sensitivity		4			   
struct compx
{
	float real;
	float imag;
};
struct compx ADC_buf[65];
data struct compx temp; 
code float iw[64]=
{
	 1.0000, 0     , 0.9952,-0.0980, 0.9808,-0.1951, 0.9569,-0.2903,
	 0.9239,-0.3827, 0.8819,-0.4714, 0.8315,-0.5556, 0.7730,-0.6344,
	 0.7071,-0.7071, 0.6344,-0.7730, 0.5556,-0.8315, 0.4714,-0.8819,
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	-0.9239,-0.3827,-0.9569,-0.2903,-0.9808,-0.1951,-0.9952,-0.0980
};
unsigned char code LED_table2[65][64]={
0x00,0x00,0x00,0x00,0x00,0x00,0x00,0x00,0x00,0x00,0x00,0x00,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0x00,
0xfe,0x00,0x00,0x00,0x00,0x00,0x00,0x00,0x00,0x00,0x00,0x00,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0x00,
0xfe,0xfe,0x00,0x00,0x00,0x00,0x00,0x00,0x00,0x00,0x00,0x00,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0x00,
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0xfe,0xfe,0xfe,0xfe,0xfe,0xfe,0xfe,0xfe,0xfe,0xfe,0xfe,0xfe,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0xfe,

};

unsigned char xdata pic2[64][16]=
{
0x00,0x00,0x00,0x00,0x00,0x00,0x00,0x00,0x00,0x00,0x00,0x00,0x00,0x00,0x00,0x00,
0x00,0x00,0x00,0x00,0x00,0x00,0x00,0x00,0x00,0x00,0x00,0x00,0x00,0x00,0x00,0x00,
0x00,0x00,0x00,0x00,0x00,0x00,0x00,0x00,0x00,0x00,0x00,0x00,0x00,0x00,0x00,0x00,
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0x00,0x00,0x00,0x00,0x00,0x00,0x00,0x00,0x00,0x00,0x00,0x00,0x00,0x00,0x00,0x00,
};
unsigned char idata refreshflag[16];	
unsigned char idata LEDBuf[16];	
unsigned char idata LED_out[16];
unsigned char vv[16], vvd[16];
float  tempOUTADC_buf[16];
void TransferData(char data1,bit DI);
void DisplayGraphic();
void DelayXus(unsigned char n);
void Init12864(void);
unsigned int  GetADCResult10(unsigned char  ch);
void processfft(void);
void initfft(void);
void InitADC();
void Init(void);
void Fill_up0();
void Fill_up1();

unsigned char idata Mode=0; tmp_Max=32;	

void    main(void)
{
	unsigned char idata i;
	InitADC();
	initfft();
	Init12864(); 	
	DisplayGraphic();
	Init();
		while(1)
		{
			if(Rest==0)IAP_CONTR=0x60;
			
			for(i=0;i<65;i++)
			{  
				ADC_buf[i].real=GetADCResult10(7);	  
			}
				processfft();
			DisplayGraphic();
		}
}
void Fill_up0()
{
	unsigned char idata i,j;

	for(i=0;i<16;i++)
	{
		for(j=0;j<32;j++)
		{
			pic2[63-j][i]=LED_table2[LEDBuf[i]][j/2];	
		}
	}
}
void Fill_up1()
{
	unsigned char idata i,j;

	for(i=0;i<16;i++)
	{
		for(j=0;j<64;j++)
		{
			pic2[63-j][i]=LED_table2[LEDBuf[i]][j/3];	
		}
	}
}
void Init12864(void)           
{
	DelayXus(40);             
	PSB=1;                 
	DelayXus(1);              
	RES=0;                
	DelayXus(1);              
	RES=1;                 
	DelayXus(10);	
	TransferData(0x36,0);  
	DelayXus(100);            
	TransferData(0x36,0);  
	DelayXus(37);             
	TransferData(0x3E,0);  
	DelayXus(100);            
	TransferData(0x01,0);  
	DelayXus(100);            
}

void    TransferData(unsigned char data1,bit DI)  //????????,?DI=0?,????,?DI=1,????.
{
	WRD=0;
	RS=DI;
	DelayXus(24);
	P0=data1;
	E=1;
	DelayXus(24);
	E=0;
}

void DisplayGraphic()
{

   unsigned char idata i,j;

   for(i=0;i<32;i++)           
    { 
      TransferData((0x80 + i),0); 
      TransferData(0x80,0);       
      for(j=0;j<16;j++)
       {
         TransferData(pic2[i][j],1);
       }
    }

   for(i=0;i<32;i++)              
    {
      TransferData((0x80 + i),0); 
      TransferData(0x88,0);      
      for(j=0;j<16;j++)
       {
        TransferData(pic2[i+32][j],1);
       }
    }
}

 void DelayXus(unsigned char idata n)
{
    while (n--)
    {
        _nop_();
        _nop_();
		_nop_();
        _nop_();
    }
}

unsigned int  GetADCResult10(unsigned char  ch)
{
    ADC_CONTR = ADC_POWER | ADC_SPEEDHH | ch | ADC_START;
    _nop_();                        
    _nop_();
    _nop_();
    _nop_();
    while (!(ADC_CONTR & ADC_FLAG));
    ADC_CONTR &= ~ADC_FLAG;         
    return (ADC_RES<<2+ADC_RESL);                
}
void initfft(void)
{
	unsigned char i;
	for(i=0;i<16;i++){
		refreshflag[i]=0;
		vv[i]= 0;
		vvd[i]= 0;
	}
}
void ee(struct compx b1,unsigned char data b2)
{ 
	temp.real=b1.real*iw[2*b2]-b1.imag*iw[2*b2+1];
	temp.imag=b1.real*iw[2*b2+1]+b1.imag*iw[2*b2]; 
}

unsigned int mypow(unsigned char data nbottom,unsigned char data ntop)
{
    unsigned int data result=1;
    unsigned char data t;    
    for(t=0;t<ntop;t++)result*=nbottom; 
    return result;
}
void fft(struct compx *xin,unsigned char data N)
{
	unsigned char data  fftnum,i,j,k,l,m,n,disbuff,dispos,dissec;
	data struct compx t;
	fftnum=N;                         
	for(m=1;(fftnum=fftnum/2)!=1;m++);
	for(k=0;k<=N-1;k++){               
		n=k;
		j=0; 
		for(i=m;i>0;i--){             
			j=j+((n%2)<<(i-1));
			n=n/2;
		} 
		if(k<j){t=xin[1+j];xin[1+j]=xin[1+k];xin[1+k]=t;}
	}  
	for(l=1;l<=m;l++){               
		disbuff=mypow(2,l);         
		dispos=disbuff/2;            
		for(j=1;j<=dispos;j++){
			for(i=j;i<N;i=i+disbuff){
				dissec=i+dispos;     
				ee(xin[dissec],(unsigned int)(j-1)*(unsigned int)N/disbuff);
				t=temp;
				xin[dissec].real=xin[i].real-t.real;
				xin[dissec].imag=xin[i].imag-t.imag;
				xin[i].real=xin[i].real+t.real;
				xin[i].imag=xin[i].imag+t.imag;
			}
		}
	}
}
void processfft(void)
{ 
    unsigned char data pt=0,tmp,i,p,p1,p2; 
    for(pt=0;pt<65;pt++){
        ADC_buf[pt].imag=0;              
    }
    fft(ADC_buf,64);                     
	 
    for(pt=2,i=0;pt<34;pt+=2){                                      
        tempOUTADC_buf[i++] = sqrt(ADC_buf[pt].real*ADC_buf[pt].real+ADC_buf[pt].imag*ADC_buf[pt].imag);//???? 
    }

	for(i=0,pt=15;i<16;i++,pt--)
	{ 
	 tmp = ((unsigned char)tempOUTADC_buf[i]) >> Process_sensitivity;

if(tmp<=1)tmp=0;      
if(tmp>p)
{
p1=(tmp-p);
if(p1>3)
{
p2=(p1-3);
tmp=(tmp-p2);
p=tmp;
}
}
if(tmp<p)
{
p1=(p-tmp);
if(p1>3)
{
p2=(p1-3);
tmp=(tmp+p2);
p=tmp;
}
} 
		if(refreshflag[i] <= tmp)
		{	
			refreshflag[i] = tmp;
		}else
		{
		 	if(refreshflag[i]>0)refreshflag[i]--;	
			tmp = refreshflag[i];
		}
		if(tmp>tmp_Max)tmp = tmp_Max; 								
		   LEDBuf[i] = tmp;
	}
}
void Delay(unsigned int n)
{
    unsigned int  x;

    while (n--)
	{
        x = 5000;
        while (x--);
    }
}
void InitADC()
{
	P1ASF =0x80;
    ADC_RES = 0; 
	ADC_RESL = 0;                  
    ADC_CONTR = ADC_POWER | ADC_SPEEDLL;
    Delay(2);                       
}

void Init(void)	
{
	P0M1=0x00;
	P0M0=0x00;
	P1M1=0xc0; 
	P1M0=0x00; 
	EA=1;
	IT0=1;
	EX0=1;
	ET1 = 1;    
	AUXR &= 0xbf;		
	TMOD = 0x00;	
	TL1 = 0xC0;			//20ms@24.000MHz
	TH1 = 0x63;	
	TF1 = 0;	
	TR1 = 1;		
}
void INT_0(void) interrupt 0  	
{
	EX0=0;
	 	Mode++;
			if(Mode==1)tmp_Max=64;  
			if(Mode>1)IAP_CONTR=0x60;
 	EX0=1;
}
void LEDRefresh_INT() interrupt 3  using 1
{  
	switch (Mode)
	{
		case 0:Fill_up0();break;
		case 1:Fill_up1();break;
		default:break; 
	}
		
}  